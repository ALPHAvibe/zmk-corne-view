## boards/shields/corne_right/Kconfig.defconfig
```kconfig
# Copyright (c) 2024 The ZMK Contributors
# SPDX-License-Identifier: MIT

if SHIELD_CORNE_RIGHT

config ZMK_SPLIT
    default y

config ZMK_SPLIT_ROLE_CENTRAL
    default n

endif # SHIELD_CORNE_RIGHT
```

## boards/shields/corne_right/Kconfig.shield
```kconfig
# Copyright (c) 2024 The ZMK Contributors
# SPDX-License-Identifier: MIT

config SHIELD_CORNE_RIGHT
    def_bool $(shields_list_contains,corne_right)

if SHIELD_CORNE_RIGHT

config ZMK_KEYBOARD_NAME
    default "Corne"

if ZMK_DISPLAY

rsource "widgets/Kconfig"

endif # ZMK_DISPLAY

endif # SHIELD_CORNE_RIGHT
```

## boards/shields/corne_right/widgets/Kconfig
```kconfig
# Copyright (c) 2024 The ZMK Contributors
# SPDX-License-Identifier: MIT

config CUSTOM_WIDGET_STATUS
    bool "Custom status widget"
    default y
    select LVGL_USE_IMG
    select LVGL_USE_LABEL
```

## boards/shields/nice_view_custom/Kconfig.defconfig
```kconfig
if SHIELD_NICE_VIEW_CUSTOM

config LV_Z_VDB_SIZE
    default 100

config LV_DPI_DEF
    default 161

config LV_Z_BITS_PER_PIXEL
    default 1

choice LV_COLOR_DEPTH
    default LV_COLOR_DEPTH_1
endchoice

config NICE_VIEW_CUSTOM_WIDGET
    bool "Custom nice!view widget"
    default y
    select LV_USE_IMG
    select LV_USE_LABEL

endif
```
